## Documentation/devicetree/bindings/mmc/starfive-jh7110-sdio.yaml
```yaml
# SPDX-License-Identifier: GPL-2.0-only OR BSD-2-Clause
%YAML 1.2
---
$id: http://devicetree.org/schemas/mmc/starfive-jh7110-sdio.yaml#
$schema: http://devicetree.org/meta-schemas/core.yaml#

title: StarFive JH7110 SDIO Device Tree Bindings

description:
  Bindings for the JH7110 RISC-V SoC from StarFive Ltd.

allOf:
  - $ref: "synopsys-dw-mshc-common.yaml#"

maintainers:
  - William Qiu <william.qiu@starfivetech.com>

properties:
  compatible:
    const: starfive,jh7110-sdio

  reg:
    maxItems: 1

  clocks:
    minItems: 1
    items:
      - description: biu clock
      - description: ciu clock

  clock-names:
    minItems: 1
    items:
      - const: biu
      - const: ciu

  interrupts:
    maxItems: 1

  starfive,sys-syscon:
    $ref: /schemas/types.yaml#/definitions/uint32-array
    description:
      The desired number of times that the host execute tuning when needed.
      If not specified, the host will do tuning for 360 times,
      namely tuning for each degree.

required:
  - compatible
  - reg
  - clocks
  - clock-names
  - interrupts

unevaluatedProperties: false

examples:
  - |
    #include <dt-bindings/clock/starfive-jh7110.h>
    #include <dt-bindings/reset/starfive-jh7110.h>

    soc {
                 #address-cells = <2>;
                 #size-cells = <2>;

                 sdio0: mmc@16010000 {
                         compatible = "starfive,jh7110-sdio";
                         reg = <0x0 0x16010000 0x0 0x10000>;
                         clocks = <&syscrg JH7110_SYSCLK_SDIO0_AHB>,
                              <&syscrg JH7110_SYSCLK_SDIO0_SDCARD>;
                         clock-names = "biu","ciu";
                         resets = <&syscrg JH7110_SYSRST_SDIO0_AHB>;
                         reset-names = "reset";
                         interrupts = <74>;
                         fifo-depth = <32>;
                         fifo-watermark-aligned;
                         data-addr = <0>;
                 };
          };

...
```

## Documentation/devicetree/bindings/pinctrl/starfive,jh7110-aon-pinctrl.yaml
```yaml
# SPDX-License-Identifier: GPL-2.0-only OR BSD-2-Clause
%YAML 1.2
---
$id: http://devicetree.org/schemas/pinctrl/starfive,jh7110-aon-pinctrl.yaml#
$schema: http://devicetree.org/meta-schemas/core.yaml#

title: StarFive JH7110 Aon Pin Controller

description: |
  Bindings for the JH7110 RISC-V SoC from StarFive Technology Ltd.

  Out of the SoC's many pins only the ones named PAD_GPIO0 to PAD_GPIO4
  can be multiplexed and have configurable bias, drive strength,
  schmitt trigger etc.
  Some peripherals have their I/O go through the 4 "GPIOs". This also
  includes PWM.

maintainers:
  - Jianlong Huang <jianlong.huang@starfivetech.com>

properties:
  compatible:
    const: starfive,jh7110-aon-pinctrl

  reg:
    maxItems: 1

  reg-names:
    items:
      - const: control

  clocks:
    maxItems: 1

  resets:
    maxItems: 1

  gpio-controller: true

  "#gpio-cells":
    const: 2

  interrupts:
    maxItems: 1
    description: The GPIO parent interrupt.

  interrupt-controller: true

  "#interrupt-cells":
    const: 2

required:
  - compatible
  - reg
  - reg-names
  - gpio-controller
  - "#gpio-cells"
  - interrupts
  - interrupt-controller
  - "#interrupt-cells"

patternProperties:
  '-[0-9]+$':
    type: object
    patternProperties:
      '-pins$':
        type: object
        description: |
          A pinctrl node should contain at least one subnode representing the
          pinctrl groups available on the machine. Each subnode will list the
          pins it needs, and how they should be configured, with regard to
          muxer configuration, system signal configuration, pin groups for
          vin/vout module, pin voltage, mux functions for output, mux functions
          for output enable, mux functions for input.

        properties:
          pinmux:
            description: |
              The list of GPIOs and their mux settings that properties in the
              node apply to. This should be set using the GPIOMUX macro.
            $ref: "/schemas/pinctrl/pinmux-node.yaml#/properties/pinmux"

          bias-disable: true

          bias-pull-up:
            type: boolean

          bias-pull-down:
            type: boolean

          drive-strength:
            enum: [ 2, 4, 8, 12 ]

          input-enable: true

          input-disable: true

          input-schmitt-enable: true

          input-schmitt-disable: true

          slew-rate:
            maximum: 1

        additionalProperties: false

    additionalProperties: false

additionalProperties: false

examples:
  - |
    #include <dt-bindings/clock/starfive-jh7110.h>
    #include <dt-bindings/reset/starfive-jh7110.h>
    #include <dt-bindings/pinctrl/pinctrl-starfive-jh7110.h>

        soc {
                #address-cells = <2>;
                #size-cells = <2>;

                gpioa: gpio@17020000 {
                        compatible = "starfive,jh7110-aon-pinctrl";
                        reg = <0x0 0x17020000 0x0 0x10000>;
                        reg-names = "control";
                        resets = <&aoncrg_rst JH7110_AONRST_AON_IOMUX>;
                        interrupts = <85>;
                        interrupt-controller;
                        #interrupt-cells = <2>;
                        #gpio-cells = <2>;
                        gpio-controller;
                };
        };

...
```

## Documentation/devicetree/bindings/pinctrl/starfive,jh7110-sys-pinctrl.yaml
```yaml
# SPDX-License-Identifier: GPL-2.0-only OR BSD-2-Clause
%YAML 1.2
---
$id: http://devicetree.org/schemas/pinctrl/starfive,jh7110-sys-pinctrl.yaml#
$schema: http://devicetree.org/meta-schemas/core.yaml#

title: StarFive JH7110 Sys Pin Controller

description: |
  Bindings for the JH7110 RISC-V SoC from StarFive Technology Ltd.

  Out of the SoC's many pins only the ones named PAD_GPIO0 to PAD_GPIO63
  can be multiplexed and have configurable bias, drive strength,
  schmitt trigger etc.
  Some peripherals have their I/O go through the 64 "GPIOs". This also
  includes a number of other UARTs, I2Cs, SPIs, PWMs etc.
  All these peripherals are connected to all 64 GPIOs such that
  any GPIO can be set up to be controlled by any of the peripherals.

maintainers:
  - Jianlong Huang <jianlong.huang@starfivetech.com>

properties:
  compatible:
    const: starfive,jh7110-sys-pinctrl

  reg:
    maxItems: 1

  reg-names:
    items:
      - const: control

  clocks:
    maxItems: 1

  resets:
    maxItems: 1

  gpio-controller: true

  "#gpio-cells":
    const: 2

  interrupts:
    maxItems: 1
    description: The GPIO parent interrupt.

  interrupt-controller: true

  "#interrupt-cells":
    const: 2

required:
  - compatible
  - reg
  - reg-names
  - clocks
  - gpio-controller
  - "#gpio-cells"
  - interrupts
  - interrupt-controller
  - "#interrupt-cells"

patternProperties:
  '-[0-9]+$':
    type: object
    patternProperties:
      '-pins$':
        type: object
        description: |
          A pinctrl node should contain at least one subnode representing the
          pinctrl groups available on the machine. Each subnode will list the
          pins it needs, and how they should be configured, with regard to
          muxer configuration, system signal configuration, pin groups for
          vin/vout module, pin voltage, mux functions for output, mux functions
          for output enable, mux functions for input.

        properties:
          pinmux:
            description: |
              The list of GPIOs and their mux settings that properties in the
              node apply to. This should be set using the GPIOMUX macro.
            $ref: "/schemas/pinctrl/pinmux-node.yaml#/properties/pinmux"

          bias-disable: true

          bias-pull-up:
            type: boolean

          bias-pull-down:
            type: boolean

          drive-strength:
            enum: [ 2, 4, 8, 12 ]

          input-enable: true

          input-disable: true

          input-schmitt-enable: true

          input-schmitt-disable: true

          slew-rate:
            maximum: 1

        additionalProperties: false

    additionalProperties: false

additionalProperties: false

examples:
  - |
    #include <dt-bindings/clock/starfive-jh7110.h>
    #include <dt-bindings/reset/starfive-jh7110.h>
    #include <dt-bindings/pinctrl/pinctrl-starfive-jh7110.h>

        soc {
                #address-cells = <2>;
                #size-cells = <2>;

                gpio: gpio@13040000 {
                        compatible = "starfive,jh7110-sys-pinctrl";
                        reg = <0x0 0x13040000 0x0 0x10000>;
                        reg-names = "control";
                        clocks = <&syscrg_clk JH7110_SYSCLK_IOMUX>;
                        resets = <&syscrg_rst JH7110_SYSRST_IOMUX>;
                        interrupts = <86>;
                        interrupt-controller;
                        #interrupt-cells = <2>;
                        #gpio-cells = <2>;
                        gpio-controller;
                        status = "okay";

                        uart0_pins: uart0-0 {
                                tx-pins {
                                        pinmux = <GPIOMUX(5, GPOUT_SYS_UART0_TX, GPOEN_ENABLE, GPI_NONE)>;
                                        bias-disable;
                                        drive-strength = <12>;
                                        input-disable;
                                        input-schmitt-disable;
                                        slew-rate = <0>;
                                };

                                rx-pins {
                                        pinmux = <GPIOMUX(6, GPOUT_LOW, GPOEN_DISABLE, GPI_SYS_UART0_RX)>;
                                        bias-pull-up;
                                        drive-strength = <2>;
                                        input-enable;
                                        input-schmitt-enable;
                                        slew-rate = <0>;
                                };
                        };
                };

                uart0 {
                        pinctrl-names = "default";
                        pinctrl-0 = <&uart0_pins>;
                        status = "okay";
                };
        };

...
```
