## kernel/trace/rv/monitors/dovetail/Kconfig
```kconfig
# SPDX-License-Identifier: GPL-2.0-only
#
config RV_MON_DOVETAIL
	depends on RV
	depends on DOVETAIL
	bool "dovetail monitor"
	help
	  Collection of per-task monitors checking that Dovetail and its
	  companion core keep their contract: stage switches, out-of-band
	  traps and signals. Enable this to enable all of them.

	  For further information, see:
	    Documentation/trace/rv/monitor_dovetail.rst
```

## kernel/trace/rv/monitors/offstage/Kconfig
```kconfig
# SPDX-License-Identifier: GPL-2.0-only
#
config RV_MON_OFFSTAGE
	depends on RV
	depends on RV_MON_DOVETAIL
	default y
	select DA_MON_EVENTS_ID
	bool "offstage monitor"
	help
	  Per-task monitor following which stage a dovetailed task runs on,
	  in-band or out-of-band. It reports a task that Linux schedules, or
	  that raises a signal on itself, while Dovetail has it out-of-band.

	  For further information, see:
	    Documentation/trace/rv/monitor_dovetail.rst
```

## kernel/trace/rv/monitors/oob_signal/Kconfig
```kconfig
# SPDX-License-Identifier: GPL-2.0-only
#
config RV_MON_OOB_SIGNAL
	depends on RV
	depends on RV_MON_DOVETAIL
	depends on !ARM
	default y
	select DA_MON_EVENTS_ID
	bool "oob_signal monitor"
	help
	  Per-task monitor checking that a dovetailed task which receives a
	  signal while out-of-band does not return to user mode out-of-band
	  without a mayday pending, since signals are delivered in-band only.

	  For further information, see:
	    Documentation/trace/rv/monitor_dovetail.rst
```

## kernel/trace/rv/monitors/oob_trap/Kconfig
```kconfig
# SPDX-License-Identifier: GPL-2.0-only
#
config RV_MON_OOB_TRAP
	depends on RV
	depends on RV_MON_DOVETAIL
	default y
	select HA_MON_EVENTS_ID
	bool "oob_trap monitor"
	help
	  Per-task monitor checking the Dovetail trap contract: every
	  exception the arch code must notify, taken out-of-band, is notified
	  with its trap number, every notification is unwound once for the
	  same trap, the trap exit handler returns with hard irqs off, a
	  kernel mode exception over a context with hard irqs off keeps them
	  off, no task is demoted from interrupt or NMI context, no task
	  schedules out while a kprobe is being handled, and every trap ends
	  within timeout_ms. With EVL, a kernel mode trap must also end on
	  the stage it was notified from, and the task must be demoted for
	  every user mode trap.

	  For further information, see:
	    Documentation/trace/rv/monitor_dovetail.rst
```
